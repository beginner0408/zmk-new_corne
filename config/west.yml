## config/west.yml
```yaml
manifest:
  remotes:
    - name: zmkfirmware
      url-base: https://github.com/zmkfirmware
      # Additional modules containing boards/shields/custom code can be listed here as well.
      # See:
      # - https://zmk.dev/docs/features/modules
      # - https://docs.zephyrproject.org/3.5.0/develop/west/manifest.html#projects
    - name: beginner0408
      url-base: https://github.com/beginner0408
    - name: urob
      url-base: https://github.com/urob
  projects:
    - name: zmk
      remote: zmkfirmware
      revision: v0.3.0
      import: app/west.yml
    - name: urchin-peripheral-animation
      remote: beginner0408
      revision: main
    - name: zmk-helpers
      remote: urob
      revision: v2
  self:
    path: config
```
